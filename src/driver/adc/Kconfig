## src/driver/adc/Kconfig
```kconfig
mainmenu "Adc AC 50Hz"
#
# ADC options
#
menuconfig ADC_AC
	bool "ADC drivers"
	depends on !ADC && SOC_FAMILY_STM32 
	# All platforms that implement the ADC driver are now required to
	# provide relevant DTS entries.
	help
	  Enable ADC (Analog to Digital Converter) driver configuration.

if ADC_AC

config ADC_ASYNC
	bool "Enable asynchronous call support"
	select POLL
    # select ADC_ASYNC
	help
	  This option enables the asynchronous API calls.

config ADC_STM32_AC_CURRENT
	bool "STM32 ADC driver for mesure 50Hz AC current AS712 sensor"
	depends on SOC_FAMILY_STM32  && !ADC_STM32
	select USE_STM32_LL_TIM
	help
	  Enable the driver implementation for the stm32xx ADC for mesure 50Hz AC current AS712 sensor

if ADC_STM32_AC_CURRENT

module = ADCAC
module-str = ADCAC
source "subsys/logging/Kconfig.template.log_config"

config ADC_STM32_AC_CURRENT_SAMPLE_TIME
	int "STM32 ADC driver sample time"
    default 2
	help
	  Conversion time in ADC cycles. Many values should have been 0.5 less,
 	  but the adc api system currently does not support describing half cycles,
	  so all half cycles are counted as one.	  
	  2, 8, 14, 29, 42, 56, 72, 240

config ADC_STM32_AC_CURRENT_OVERSAMPLING
	int "STM32 ADC driver 50Hz current periods count"
    default 64
	help
	  50Hz current periods count
	  SCAN_COUNT = ADC_STM32_AC_CURRENT_OVERSAMPLING*4

endif # ADC_STM32_AC_CURRENT

endif # ADC
```

## src/driver/am2320/Kconfig
```kconfig
menuconfig AM2320
	bool "AM2320 driver"
	help
	  Enable AM2320 sensor driver configuration.

if AM2320

endif
```

## src/driver/bh1750/Kconfig
```kconfig
menuconfig BH1750
	bool "BH1750 driver"
	help
	  Enable BH1750 Light sensor driver configuration.

if BH1750

endif
```

## src/driver/shell/Kconfig
```kconfig
config SHELL_BACKEND_CANOPEN
	bool "Enable CANOPEN backend"
	select CONSOLE
	# select CANOPEN_CONSOLE
	help
	  Enable CANOPEN backend.

if SHELL_BACKEND_CANOPEN

config SHELL_PROMPT_CANOPEN
	string "Displayed prompt name"
	default "~$ "
	help
	  Displayed prompt name for CANOPEN backend.

config SHELL_CANOPEN_RX_POLL_PERIOD
	int "RX polling period (in milliseconds)"
	default 10
	help
	  Determines how often CANOPEN is polled for RX byte.

module = SHELL_BACKEND_CANOPEN
default-timeout = 100
source "subsys/shell/Kconfig.template.shell_log_queue_timeout"

default-size = 10
source "subsys/shell/Kconfig.template.shell_log_queue_size"

choice
	prompt "Initial log level limit"
	default SHELL_CANOPEN_INIT_LOG_LEVEL_DEFAULT

config SHELL_CANOPEN_INIT_LOG_LEVEL_DEFAULT
	bool "System limit (LOG_MAX_LEVEL)"

config SHELL_CANOPEN_INIT_LOG_LEVEL_DBG
	bool "Debug"

config SHELL_CANOPEN_INIT_LOG_LEVEL_INF
	bool "Info"

config SHELL_CANOPEN_INIT_LOG_LEVEL_WRN
	bool "Warning"

config SHELL_CANOPEN_INIT_LOG_LEVEL_ERR
	bool "Error"

config SHELL_CANOPEN_INIT_LOG_LEVEL_NONE
	bool "None"

endchoice

config SHELL_CANOPEN_INIT_LOG_LEVEL
	int
	default 0 if SHELL_CANOPEN_INIT_LOG_LEVEL_NONE
	default 1 if SHELL_CANOPEN_INIT_LOG_LEVEL_ERR
	default 2 if SHELL_CANOPEN_INIT_LOG_LEVEL_WRN
	default 3 if SHELL_CANOPEN_INIT_LOG_LEVEL_INF
	default 4 if SHELL_CANOPEN_INIT_LOG_LEVEL_DBG
	default 5 if SHELL_CANOPEN_INIT_LOG_LEVEL_DEFAULT

module = SHELL_CANOPEN
module-str = CANOPEN shell backend
source "subsys/logging/Kconfig.template.log_config"

endif # SHELL_BACKEND_CANOPEN
```
